#include "ArduinoWhirpool.h"

#include <avr/pgmspace.h>
#include <string.h>

namespace whirpool {
	
	const PROGMEM uint8_t Cx [256*sizeof(uint64_t)] = {
		0x18,0x18,0x60,0x18,0xc0,0x78,0x30,0xd8,
		0x23,0x23,0x8c,0x23,0x05,0xaf,0x46,0x26,
		0xc6,0xc6,0x3f,0xc6,0x7e,0xf9,0x91,0xb8,
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		0x86,0x86,0x22,0x86,0x44,0xa4,0x11,0xc2
	};
	
	static const union {
		uint8_t c [10*sizeof(uint64_t)];
		uint64_t q [10];
	} Rc = { {
		0x18,0x23,0xc6,0xe8,0x87,0xb8,0x01,0x4f,
		0x36,0xa6,0xd2,0xf5,0x79,0x6f,0x91,0x52,
		0x60,0xbc,0x9b,0x8e,0xa3,0x0c,0x7b,0x35,
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		0xca,0x2d,0xbf,0x07,0xad,0x5a,0x83,0x33
	} };
	
	template <uint8_t N>
	inline uint64_t C (const union u64o& k, uint8_t i) {
        	uint16_t p = k.c[i*8+N]*8;
		uint64_t q = (uint64_t)pgm_read_dword_near(Cx+p) | (uint64_t)pgm_read_dword_near(Cx+p+4) << 32;
		return ( q << 8*N ^ q >> (8*(8-N)) );
	}
	template <>
	inline uint64_t C<0> (const union u64o& k, uint8_t i) {
        	uint16_t p = k.c[i*8]*8;
		uint64_t q = (uint64_t)pgm_read_dword_near(Cx+p) | (uint64_t)pgm_read_dword_near(Cx+p+4) << 32;
		return q;
	}
	
	void _update_block (struct whirpool::ctx_t*);
}

void whirpool::init (struct whirpool::ctx_t* ctx) {
	::memset(ctx, 0x0, sizeof(struct whirpool::ctx_t));
}

void whirpool::update (struct whirpool::ctx_t* ctx, const void* data, size_t bytes) {
	const uint8_t* p = (const uint8_t*)data;
	ctx->bitlen[0] += bytes*8;
	if (ctx->bitlen[0] < bytes*8) { // bitlen overflow
		size_t n = 1;
		do { ctx->bitlen[n]++; } while (ctx->bitlen[n] == 0 && ++n < WHIRLPOOL_COUNTER/sizeof(size_t));
	}
	while (bytes) {
		uint8_t b;
		b = p[0] | (p[1] >> 8);
		ctx->data[ctx->byteoff++] = b;
		bytes--;
		p++;
		if (ctx->byteoff >= WHIRLPOOL_BLOCK) {
			whirpool::_update_block(ctx);
			ctx->byteoff %= WHIRLPOOL_BLOCK;
		}
	}
}

void whirpool::final (struct whirpool::ctx_t* ctx) {
	ctx->data[ctx->byteoff++] = 0x80;
	if (ctx->byteoff > WHIRLPOOL_BLOCK - WHIRLPOOL_COUNTER) {
		if (ctx->byteoff < WHIRLPOOL_BLOCK)
			::memset(&ctx->data[ctx->byteoff], 0x0, WHIRLPOOL_BLOCK - ctx->byteoff);
		whirpool::_update_block(ctx);
		ctx->byteoff = 0;
	}
	else if (ctx->byteoff < WHIRLPOOL_BLOCK - WHIRLPOOL_COUNTER)
		::memset(&ctx->data[ctx->byteoff], 0x0, WHIRLPOOL_BLOCK - WHIRLPOOL_COUNTER - ctx->byteoff);
	uint8_t* p = &ctx->data[WHIRLPOOL_BLOCK-1];
	for (size_t i = 0; i < WHIRLPOOL_COUNTER/sizeof(size_t); i++) 
		for (size_t j=0, v = ctx->bitlen[i]; j < sizeof(size_t); j++, v>>=8) 
			*p-- = (uint8_t)(v & 0xff);
	whirpool::_update_block(ctx);
}

void whirpool::_update_block (struct whirpool::ctx_t* ctx) {
	const uint64_t* pq = (const uint64_t*)ctx->data;
	union u64o S, K;
	uint64_t L0, L1, L2, L3, L4, L5, L6, L7;
	S.q[0] = (K.q[0] = ctx->H.q[0]) ^ pq[0];
	S.q[1] = (K.q[1] = ctx->H.q[1]) ^ pq[1];
	S.q[2] = (K.q[2] = ctx->H.q[2]) ^ pq[2];
	S.q[3] = (K.q[3] = ctx->H.q[3]) ^ pq[3];
	S.q[4] = (K.q[4] = ctx->H.q[4]) ^ pq[4];
	S.q[5] = (K.q[5] = ctx->H.q[5]) ^ pq[5];
	S.q[6] = (K.q[6] = ctx->H.q[6]) ^ pq[6];
	S.q[7] = (K.q[7] = ctx->H.q[7]) ^ pq[7];
	for (uint8_t r = 0; r < 10; r++) {
		L0 = C<0>(K,0) ^ C<1>(K,7) ^ C<2>(K,6) ^ C<3>(K,5) ^ C<4>(K,4) ^ C<5>(K,3) ^ C<6>(K,2) ^ C<7>(K,1) ^ Rc.q[r];
		L1 = C<0>(K,1) ^ C<1>(K,0) ^ C<2>(K,7) ^ C<3>(K,6) ^ C<4>(K,5) ^ C<5>(K,4) ^ C<6>(K,3) ^ C<7>(K,2);
		L2 = C<0>(K,2) ^ C<1>(K,1) ^ C<2>(K,0) ^ C<3>(K,7) ^ C<4>(K,6) ^ C<5>(K,5) ^ C<6>(K,4) ^ C<7>(K,3);
		L3 = C<0>(K,3) ^ C<1>(K,2) ^ C<2>(K,1) ^ C<3>(K,0) ^ C<4>(K,7) ^ C<5>(K,6) ^ C<6>(K,5) ^ C<7>(K,4);
		L4 = C<0>(K,4) ^ C<1>(K,3) ^ C<2>(K,2) ^ C<3>(K,1) ^ C<4>(K,0) ^ C<5>(K,7) ^ C<6>(K,6) ^ C<7>(K,5);
		L5 = C<0>(K,5) ^ C<1>(K,4) ^ C<2>(K,3) ^ C<3>(K,2) ^ C<4>(K,1) ^ C<5>(K,0) ^ C<6>(K,7) ^ C<7>(K,6);
		L6 = C<0>(K,6) ^ C<1>(K,5) ^ C<2>(K,4) ^ C<3>(K,3) ^ C<4>(K,2) ^ C<5>(K,1) ^ C<6>(K,0) ^ C<7>(K,7);
		L7 = C<0>(K,7) ^ C<1>(K,6) ^ C<2>(K,5) ^ C<3>(K,4) ^ C<4>(K,3) ^ C<5>(K,2) ^ C<6>(K,1) ^ C<7>(K,0);
		K.q[0] = L0; K.q[1] = L1; K.q[2] = L2; K.q[3] = L3; K.q[4] = L4; K.q[5] = L5; K.q[6] = L6; K.q[7] = L7;
		L0 ^= C<0>(S,0) ^ C<1>(S,7) ^ C<2>(S,6) ^ C<3>(S,5) ^ C<4>(S,4) ^ C<5>(S,3) ^ C<6>(S,2) ^ C<7>(S,1);
		L1 ^= C<0>(S,1) ^ C<1>(S,0) ^ C<2>(S,7) ^ C<3>(S,6) ^ C<4>(S,5) ^ C<5>(S,4) ^ C<6>(S,3) ^ C<7>(S,2);
		L2 ^= C<0>(S,2) ^ C<1>(S,1) ^ C<2>(S,0) ^ C<3>(S,7) ^ C<4>(S,6) ^ C<5>(S,5) ^ C<6>(S,4) ^ C<7>(S,3);
		L3 ^= C<0>(S,3) ^ C<1>(S,2) ^ C<2>(S,1) ^ C<3>(S,0) ^ C<4>(S,7) ^ C<5>(S,6) ^ C<6>(S,5) ^ C<7>(S,4);
		L4 ^= C<0>(S,4) ^ C<1>(S,3) ^ C<2>(S,2) ^ C<3>(S,1) ^ C<4>(S,0) ^ C<5>(S,7) ^ C<6>(S,6) ^ C<7>(S,5);
		L5 ^= C<0>(S,5) ^ C<1>(S,4) ^ C<2>(S,3) ^ C<3>(S,2) ^ C<4>(S,1) ^ C<5>(S,0) ^ C<6>(S,7) ^ C<7>(S,6);
		L6 ^= C<0>(S,6) ^ C<1>(S,5) ^ C<2>(S,4) ^ C<3>(S,3) ^ C<4>(S,2) ^ C<5>(S,1) ^ C<6>(S,0) ^ C<7>(S,7);
		L7 ^= C<0>(S,7) ^ C<1>(S,6) ^ C<2>(S,5) ^ C<3>(S,4) ^ C<4>(S,3) ^ C<5>(S,2) ^ C<6>(S,1) ^ C<7>(S,0);
		S.q[0] = L0; S.q[1] = L1; S.q[2] = L2; S.q[3] = L3; S.q[4] = L4; S.q[5] = L5; S.q[6] = L6; S.q[7] = L7;
	}
	ctx->H.q[0] ^= S.q[0] ^ pq[0];
	ctx->H.q[1] ^= S.q[1] ^ pq[1];
	ctx->H.q[2] ^= S.q[2] ^ pq[2];
	ctx->H.q[3] ^= S.q[3] ^ pq[3];
	ctx->H.q[4] ^= S.q[4] ^ pq[4];
	ctx->H.q[5] ^= S.q[5] ^ pq[5];
	ctx->H.q[6] ^= S.q[6] ^ pq[6];
	ctx->H.q[7] ^= S.q[7] ^ pq[7];
}
